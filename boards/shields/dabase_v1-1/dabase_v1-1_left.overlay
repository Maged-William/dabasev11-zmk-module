/*
 * Copyright (c) 2022 Duccio Breschi
 *
 * SPDX-License-Identifier: MIT
 */

#include "dabase_v1-1.dtsi"

&kscan0 {
    diode-direction = "col2row";
    col-gpios
        = <&gpio1 11 GPIO_ACTIVE_HIGH>
        , <&gpio1 13 GPIO_ACTIVE_HIGH>
        , <&gpio1 15 GPIO_ACTIVE_HIGH>
        , <&gpio0 2  GPIO_ACTIVE_HIGH>
        , <&gpio0 29 GPIO_ACTIVE_HIGH>
        , <&gpio0 31 GPIO_ACTIVE_HIGH>
    ;

    row-gpios
        = <&gpio0 10  (GPIO_ACTIVE_HIGH | GPIO_PULL_DOWN)>
        , <&gpio0 9   (GPIO_ACTIVE_HIGH | GPIO_PULL_DOWN)>
        , <&gpio0 22  (GPIO_ACTIVE_HIGH | GPIO_PULL_DOWN)>
        , <&gpio0 24  (GPIO_ACTIVE_HIGH | GPIO_PULL_DOWN)>
        , <&gpio1 0   (GPIO_ACTIVE_HIGH | GPIO_PULL_DOWN)>
        , <&gpio0 11  (GPIO_ACTIVE_HIGH | GPIO_PULL_DOWN)>
        , <&gpio1 4   (GPIO_ACTIVE_HIGH | GPIO_PULL_DOWN)>
        , <&gpio1 7   (GPIO_ACTIVE_HIGH | GPIO_PULL_DOWN)>
    ;
};

left_encoder: encoder_left {
    compatible = "alps,ec11";
    a-gpios = <&gpio0 8 (GPIO_ACTIVE_HIGH | GPIO_PULL_UP)>;
    b-gpios = <&gpio0 6 (GPIO_ACTIVE_HIGH | GPIO_PULL_UP)>;
    label = "LEFT_ENCODER";
	resolution = <4>;
    status = "disabled";
};

sensors: sensors {
    compatible = "zmk,keymap-sensors";
    sensors = <&left_encoder>;
    triggers-per-rotation = <20>;
};
